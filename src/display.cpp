#include "display.h"
#include "driver/i2c_master.h"
#include "esp_log.h"
#include <string.h>
#include <stdio.h>

#define OLED_I2C_ADDRESS            0x3C
#define OLED_WIDTH                  128
#define OLED_HEIGHT                 64
#define OLED_PAGES                  8

static uint8_t display_buffer[OLED_WIDTH * OLED_PAGES];
static i2c_master_dev_handle_t oled_handle;

/* minimal 5x7 font for ASCII 32 to 127 */
// Credits to this website article where I found the font:
// https://www.engineersgarage.com/how-to-display-string-on-graphics-lcd-using-8051-microcontroller-at89c52-part-44-45/
static const uint8_t font5x7[][5] = {
    {0x00,0x00,0x00,0x00,0x00}, {0x00,0x00,0x5F,0x00,0x00}, {0x00,0x07,0x00,0x07,0x00}, {0x14,0x7F,0x14,0x7F,0x14},
    {0x24,0x2A,0x7F,0x2A,0x12}, {0x23,0x13,0x08,0x64,0x62}, {0x36,0x49,0x55,0x22,0x50}, {0x00,0x05,0x03,0x00,0x00},
    {0x00,0x1C,0x22,0x41,0x00}, {0x00,0x41,0x22,0x1C,0x00}, {0x08,0x2A,0x1C,0x2A,0x08}, {0x08,0x08,0x3E,0x08,0x08},
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    {0x00,0x00,0x7F,0x00,0x00}, {0x00,0x41,0x36,0x08,0x00}, {0x08,0x08,0x2A,0x1C,0x08}, {0x08,0x08,0x08,0x08,0x08}
};

static void oled_send_cmd(uint8_t cmd) {
    uint8_t buf[2] = {0x00, cmd};
    i2c_master_transmit(oled_handle, buf, sizeof(buf), -1);
}

static void oled_send_buffer() {
    for (uint8_t i = 0; i < OLED_PAGES; i++) {
        oled_send_cmd(0xB0 + i); // page
        oled_send_cmd(0x00); // lower column
        oled_send_cmd(0x10); // higher column
        
        uint8_t tx_buf[OLED_WIDTH + 1];
        tx_buf[0] = 0x40; // control byte for data
        memcpy(&tx_buf[1], &display_buffer[i * OLED_WIDTH], OLED_WIDTH);
        
        i2c_master_transmit(oled_handle, tx_buf, sizeof(tx_buf), -1);
    }
}

void display_init() {
    i2c_master_bus_config_t i2c_mst_config = {};
    i2c_mst_config.clk_source = I2C_CLK_SRC_DEFAULT;
    i2c_mst_config.i2c_port = I2C_NUM_0;
    i2c_mst_config.scl_io_num = GPIO_NUM_22;
    i2c_mst_config.sda_io_num = GPIO_NUM_21;
    i2c_mst_config.glitch_ignore_cnt = 7;
    i2c_mst_config.flags.enable_internal_pullup = true;

    i2c_master_bus_handle_t bus_handle;
    i2c_new_master_bus(&i2c_mst_config, &bus_handle);

    i2c_device_config_t dev_cfg = {};
    dev_cfg.dev_addr_length = I2C_ADDR_BIT_LEN_7;
    dev_cfg.device_address = OLED_I2C_ADDRESS;
    dev_cfg.scl_speed_hz = 400000;
    
    i2c_master_bus_add_device(bus_handle, &dev_cfg, &oled_handle);

    // init commands
    oled_send_cmd(0xAE); // display off
    oled_send_cmd(0x20); oled_send_cmd(0x00); // horiz mode
    oled_send_cmd(0xC8); // flip
    oled_send_cmd(0xA1); // flip
    oled_send_cmd(0x8D); oled_send_cmd(0x14); // charge pump
    oled_send_cmd(0xAF); // display on

    memset(display_buffer, 0, sizeof(display_buffer));
    oled_send_buffer();
}

static void draw_pixel(int x, int y, bool color) {
    if (x < 0 || x >= OLED_WIDTH || y < 0 || y >= OLED_HEIGHT) return;
    uint8_t page = y / 8;
    uint8_t bit = y % 8;
    if (color) {
        display_buffer[page * OLED_WIDTH + x] |= (1 << bit);
    } else {
        display_buffer[page * OLED_WIDTH + x] &= ~(1 << bit);
    }
}

static void fill_rect(int x, int y, int w, int h, bool color) {
    for (int i = 0; i < w; i++) {
        for (int j = 0; j < h; j++) {
            draw_pixel(x + i, y + j, color);
        }
    }
}

static void draw_char(int x, int y, char c, bool color, bool bg_color) {
    if (c < 32 || c > 127) c = 32;
    for (int i = 0; i < 5; i++) {
        uint8_t col = font5x7[c - 32][i];
        for (int j = 0; j < 7; j++) {
            if (col & (1 << j)) {
                draw_pixel(x + i, y + j, color);
            } else {
                draw_pixel(x + i, y + j, bg_color);
            }
        }
    }
}

static void draw_string(int x, int y, const char* str, bool color, bool bg_color) {
    while (*str) {
        draw_char(x, y, *str++, color, bg_color);
        x += 6;
    }
}

static void draw_char_2x(int x, int y, char c, bool color) {
    if (c < 32 || c > 127) c = 32;
    for (int i = 0; i < 5; i++) {
        uint8_t col = font5x7[c - 32][i];
        for (int j = 0; j < 7; j++) {
            if (col & (1 << j)) {
                draw_pixel(x + i*2, y + j*2, color);
                draw_pixel(x + i*2 + 1, y + j*2, color);
                draw_pixel(x + i*2, y + j*2 + 1, color);
                draw_pixel(x + i*2 + 1, y + j*2 + 1, color);
            }
        }
    }
}

static void draw_string_2x(int x, int y, const char* str, bool color) {
    while (*str) {
        draw_char_2x(x, y, *str++, color);
        x += 12;
    }
}

void display_clear() {
    memset(display_buffer, 0, sizeof(display_buffer));
    oled_send_buffer();
}

void display_update(const SensorData* data, const char* activeMenu) {
    memset(display_buffer, 0, sizeof(display_buffer));
    
    // For the Title bar
    fill_rect(0, 0, OLED_WIDTH, 15, true);
    draw_string(10, 4, activeMenu, false, true);
    
    // draw & render the sensor value
    char buf[32];
    if (strcmp(activeMenu, "TEMPERATURE") == 0) {
        snprintf(buf, sizeof(buf), "%.1f C", data->temperature);
        draw_string_2x(10, 32, buf, true);
    } else if (strcmp(activeMenu, "HUMIDITY") == 0) {
        snprintf(buf, sizeof(buf), "%.1f %%", data->humidity);
        draw_string_2x(10, 32, buf, true);
    } else if (strcmp(activeMenu, "LIGHT") == 0) {
        snprintf(buf, sizeof(buf), "%d %%", data->lightLevel);
        draw_string_2x(10, 32, buf, true);
    } else if (strcmp(activeMenu, "MOTION") == 0) {
        snprintf(buf, sizeof(buf), "%s", data->motionDetected ? "DETECTED" : "NONE");
        draw_string_2x(10, 32, buf, true);
    } else {
        // default boot screen
        memset(display_buffer, 0, sizeof(display_buffer));
        draw_string_2x(25, 20, "BCA152", true);
        draw_string(40, 48, "FreeRTOS", true, false);
    }
    
    oled_send_buffer();
}

